## esp32/main/Kconfig.projbuild
```kconfig
menu "MediMe SPP Relay Configuration"
    config MEDIME_BT_DEVICE_NAME
        string "Bluetooth device name (SPP server)"
        default "MediMe"
        help
            Name shown when pairing. Use "MediMe" for the Android app to find the device.
endmenu
```

## esp32/sdkconfig.defaults
```kconfig
# Default configuration for MediMe ESP32 - Bluetooth Classic SPP Relay
CONFIG_ESP32_DEFAULT_CPU_FREQ_240=y
CONFIG_ESP32_DEFAULT_CPU_FREQ_MHZ=240

# Bluetooth Classic (BR/EDR) + SPP - BLE/NimBLE disabled
CONFIG_BT_ENABLED=y
CONFIG_BTDM_CTRL_MODE_BLE_ONLY=n
CONFIG_BTDM_CTRL_MODE_BR_EDR_ONLY=y
CONFIG_BTDM_CTRL_MODE_BTDM=n
CONFIG_BT_BLUEDROID_ENABLED=y
CONFIG_BT_CLASSIC_ENABLED=y
CONFIG_BT_SPP_ENABLED=y
CONFIG_BT_BLE_ENABLED=n
CONFIG_BT_NIMBLE_ENABLED=n
```
